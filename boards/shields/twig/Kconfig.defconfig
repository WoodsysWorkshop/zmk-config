## boards/shields/twig/Kconfig.defconfig
```kconfig
if SHIELD_TWIG_LEFT
        
config ZMK_KEYBOARD_NAME
    default "Twig"

config ZMK_SPLIT_ROLE_CENTRAL
    default y

config ZMK_USB
    default y

endif

if SHIELD_TWIG_LEFT || SHIELD_TWIG_RIGHT

config ZMK_SPLIT
    default y

if ZMK_DISPLAY

config I2C
    default y

config SSD1306
    default y

endif # ZMK_DISPLAY

endif
```

## boards/shields/twig/Kconfig.shield
```kconfig
config SHIELD_TWIG_LEFT
    def_bool $(shields_list_contains,twig_left)

config SHIELD_TWIG_RIGHT
    def_bool $(shields_list_contains,twig_right)
```

## config/west.yml
```yaml
manifest:
  remotes:
    - name: zmkfirmware
      url-base: https://github.com/zmkfirmware
    # support nice_oled and nice_epaper
    - name: mctechnology17
      url-base: https://github.com/mctechnology17
    # analog stick support
    - name: badjeff
      url-base: https://github.com/badjeff
  projects:
    - name: zmk
      remote: zmkfirmware
      revision: main
      import: app/west.yml
    # support nice_oled and nice_epaper
    - name: zmk-nice-oled
      remote: mctechnology17
      revision: main
    # analog stick support
    - name: zmk-analog-input-driver
      remote: badjeff
      revision: main
  self:
    path: config
```
